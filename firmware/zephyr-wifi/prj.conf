## CMakeLists.txt
```
# UNAL Flash Tool — WiFi Firmware (Zephyr RTOS)
cmake_minimum_required(VERSION 3.20.0)
find_package(Zephyr REQUIRED HINTS $ENV{ZEPHYR_BASE})
project(unal_wifi)

target_sources(app PRIVATE
  src/main.c
  src/wifi_mgr.c
  src/wifi_config.c
)
```

## prj.conf
```kconfig
# UNAL WiFi Firmware — Zephyr Configuration
# Target: Seeed XIAO ESP32-C6

# ──── Core ────
CONFIG_GPIO=y
CONFIG_CONSOLE=y
CONFIG_UART_CONSOLE=y
CONFIG_SERIAL=y
CONFIG_PRINTK=y
CONFIG_BOOT_BANNER=y
CONFIG_HEAP_MEM_POOL_SIZE=65536
CONFIG_MAIN_STACK_SIZE=8192

# ──── Logging ────
CONFIG_LOG=y
CONFIG_LOG_DEFAULT_LEVEL=3

# ──── NVS (credential storage) ────
CONFIG_NVS=y
CONFIG_FLASH=y
CONFIG_FLASH_MAP=y

# ──── Networking ────
CONFIG_NETWORKING=y
CONFIG_NET_IPV4=y
CONFIG_NET_IPV6=n
CONFIG_NET_TCP=y
CONFIG_NET_UDP=y
CONFIG_NET_DHCPV4=y
CONFIG_NET_L2_ETHERNET=y
CONFIG_NET_L2_WIFI_MGMT=y
CONFIG_NET_MGMT=y
CONFIG_NET_MGMT_EVENT=y
CONFIG_NET_MGMT_EVENT_INFO=y
CONFIG_NET_MGMT_EVENT_QUEUE_SIZE=16
CONFIG_NET_MGMT_EVENT_QUEUE_TIMEOUT=5000
CONFIG_NET_PKT_RX_COUNT=10
CONFIG_NET_PKT_TX_COUNT=10
CONFIG_NET_BUF_RX_COUNT=20
CONFIG_NET_BUF_TX_COUNT=20
CONFIG_NET_MAX_CONTEXTS=10
CONFIG_NET_LOG=y

# ──── WiFi ────
CONFIG_WIFI=y
CONFIG_WIFI_LOG_LEVEL_INF=y
CONFIG_ESP32_WIFI_STA_AUTO_DHCPV4=y
```

## src/main.c
```c
/*
 * UNAL Flash Tool — WiFi Firmware (Zephyr RTOS)
 *
 * Reads WiFi credentials from a flash config partition,
 * falls back to NVS, then connects to the configured AP.
 *
 * Credentials are provided by flashing a config binary
 * from the UNAL Flash Tool web interface at offset 0x3E0000.
 *
 * Target: Seeed XIAO ESP32-C6
 */

#include <zephyr/kernel.h>
#include <zephyr/drivers/gpio.h>
#include <zephyr/sys/printk.h>
#include <zephyr/logging/log.h>
#include <version.h>

#include "wifi_config.h"
#include "wifi_mgr.h"

LOG_MODULE_REGISTER(main, LOG_LEVEL_INF);

/* LED from devicetree alias */
#define LED_NODE DT_ALIAS(led0)

#if !DT_NODE_HAS_STATUS_OKAY(LED_NODE)
#error "LED0 alias not defined in devicetree"
#endif

static const struct gpio_dt_spec led = GPIO_DT_SPEC_GET(LED_NODE, gpios);

/* LED blink patterns (ms) */
#define BLINK_FAST    150   /* provisioning / no credentials */
#define BLINK_MEDIUM  500   /* connecting */
#define BLINK_SLOW    1000  /* connected */

int main(void)
{
	int ret;
	uint32_t count = 0;

	printk("\n========================================\n");
	printk("  UNAL Flash Tool — WiFi Firmware\n");
	printk("  Framework: Zephyr RTOS %s\n", KERNEL_VERSION_STRING);
	printk("  Board: %s\n", CONFIG_BOARD);
	printk("========================================\n\n");

	/* Initialize LED */
	if (!gpio_is_ready_dt(&led)) {
		LOG_ERR("LED GPIO not ready");
		return -1;
	}
	ret = gpio_pin_configure_dt(&led, GPIO_OUTPUT_ACTIVE);
	if (ret < 0) {
		LOG_ERR("Could not configure LED pin (%d)", ret);
		return -1;
	}

	/* Initialize WiFi manager (NVS + event callbacks) */
	ret = wifi_mgr_init();
	if (ret < 0) {
		LOG_ERR("WiFi manager init failed (%d)", ret);
	}

	/* Try loading credentials: config partition first, then NVS */
	char ssid[33] = {0};
	char psk[65] = {0};
	bool creds_found = false;

	if (wifi_config_load(ssid, sizeof(ssid), psk, sizeof(psk)) == 0 &&
	    ssid[0] != '\0') {
		LOG_INF("Credentials from config partition — SSID: %s", ssid);
		creds_found = true;
	} else if (wifi_mgr_load_credentials(ssid, sizeof(ssid),
					    psk, sizeof(psk)) == 0 &&
		   ssid[0] != '\0') {
		LOG_INF("Credentials from NVS — SSID: %s", ssid);
		creds_found = true;
	}

	if (creds_found) {
		wifi_mgr_connect(ssid, psk);
	} else {
		LOG_WRN("No WiFi credentials found");
		LOG_INF("Use the UNAL Flash Tool to flash a config binary");
	}

	/* Main loop — blink LED based on WiFi state */
	while (1) {
		gpio_pin_toggle_dt(&led);
		count++;

		enum wifi_mgr_state state = wifi_mgr_get_state();
		int blink_ms;

		switch (state) {
		case WIFI_MGR_CONNECTED:
			blink_ms = BLINK_SLOW;
			break;
		case WIFI_MGR_CONNECTING:
			blink_ms = BLINK_MEDIUM;
			break;
		default:
			blink_ms = BLINK_FAST;
			break;
		}

		if (count % 10 == 0) {
			const char *state_str;
			switch (state) {
			case WIFI_MGR_CONNECTED:
				state_str = "CONNECTED";
				break;
			case WIFI_MGR_CONNECTING:
				state_str = "CONNECTING";
				break;
			case WIFI_MGR_DISCONNECTED:
				state_str = "DISCONNECTED";
				break;
			default:
				state_str = "IDLE";
				break;
			}

			printk("[%08u] WiFi: %s | Uptime: %lld ms\n",
			       k_uptime_get_32(), state_str, k_uptime_get());
		}

		k_sleep(K_MSEC(blink_ms));
	}

	return 0;
}
```

## src/prov_shell.c
```c
/*
 * Provisioning Shell — implementation
 *
 * Handles the PROV:* serial protocol sent by the UNAL Flash Tool
 * CredentialWriter (browser side).
 *
 * Uses polling-based RX in a dedicated thread for maximum
 * compatibility with all UART backends including USB Serial/JTAG.
 *
 * Protocol:
 *   PROV:START\n       → Enter provisioning mode
 *   PROV:SET:key=val\n → Set credential in NVS
 *   PROV:COMMIT\n      → Save & connect WiFi
 *   PROV:STATUS\n      → Query current status
 *
 * Responses:
 *   PROV:OK:<info>\n
 *   PROV:ERR:<reason>\n
 */

#include <zephyr/kernel.h>
#include <zephyr/device.h>
#include <zephyr/drivers/uart.h>
#include <zephyr/logging/log.h>
#include <string.h>
#include <stdio.h>

#include "prov_shell.h"
#include "wifi_mgr.h"

LOG_MODULE_REGISTER(prov_shell, LOG_LEVEL_INF);

#define PROV_BUF_SIZE    256
#define PROV_STACK_SIZE  2048
#define PROV_POLL_MS     10    /* polling interval */

/* Provisioning state */
static bool prov_active;
static char prov_ssid[33];
static char prov_psk[65];

/* RX line buffer */
static char rx_buf[PROV_BUF_SIZE];
static int rx_pos;

/* UART device — USB Serial/JTAG on ESP32-C6 */
static const struct device *uart_dev;

/* Polling thread stack */
K_THREAD_STACK_DEFINE(prov_stack, PROV_STACK_SIZE);
static struct k_thread prov_thread_data;

static void send_response(const char *resp)
{
	const char *p = resp;
	while (*p) {
		uart_poll_out(uart_dev, *p++);
	}
	uart_poll_out(uart_dev, '\n');
}

static void handle_prov_start(void)
{
	prov_active = true;
	memset(prov_ssid, 0, sizeof(prov_ssid));
	memset(prov_psk, 0, sizeof(prov_psk));
	LOG_INF("Provisioning started");
	send_response("PROV:OK:START");
}

static void handle_prov_set(const char *payload)
{
	if (!prov_active) {
		send_response("PROV:ERR:not_started");
		return;
	}

	/* Parse key=value */
	const char *eq = strchr(payload, '=');
	if (!eq) {
		send_response("PROV:ERR:invalid_format");
		return;
	}

	/* Extract key */
	char key[32];
	size_t key_len = eq - payload;
	if (key_len >= sizeof(key)) {
		send_response("PROV:ERR:key_too_long");
		return;
	}
	memcpy(key, payload, key_len);
	key[key_len] = '\0';

	const char *value = eq + 1;

	if (strcmp(key, "wifi_ssid") == 0) {
		strncpy(prov_ssid, value, sizeof(prov_ssid) - 1);
		LOG_INF("Set wifi_ssid = %s", prov_ssid);
		send_response("PROV:OK:wifi_ssid");
	} else if (strcmp(key, "wifi_password") == 0 || strcmp(key, "wifi_pass") == 0) {
		strncpy(prov_psk, value, sizeof(prov_psk) - 1);
		LOG_INF("Set wifi_password = ****");
		send_response("PROV:OK:wifi_password");
	} else {
		LOG_WRN("Unknown credential key: %s", key);
		send_response("PROV:ERR:unknown_key");
	}
}

static void handle_prov_commit(void)
{
	if (!prov_active) {
		send_response("PROV:ERR:not_started");
		return;
	}

	if (prov_ssid[0] == '\0') {
		send_response("PROV:ERR:ssid_empty");
		return;
	}

	/* Save to NVS */
	int ret = wifi_mgr_save_credentials(prov_ssid, prov_psk);
	if (ret < 0) {
		send_response("PROV:ERR:nvs_write_failed");
		return;
	}

	LOG_INF("Credentials committed — connecting to %s", prov_ssid);
	send_response("PROV:OK:COMMIT");

	prov_active = false;

	/* Disconnect if connected, then connect with new credentials */
	wifi_mgr_disconnect();
	k_sleep(K_MSEC(500));
	wifi_mgr_connect(prov_ssid, prov_psk);
}

static void handle_prov_status(void)
{
	char buf[128];
	enum wifi_mgr_state state = wifi_mgr_get_state();
	const char *ip = wifi_mgr_get_ip();

	char ssid[33] = {0};
	char psk[65] = {0};
	wifi_mgr_load_credentials(ssid, sizeof(ssid), psk, sizeof(psk));

	const char *state_str;
	switch (state) {
	case WIFI_MGR_CONNECTED:
		state_str = "connected";
		break;
	case WIFI_MGR_CONNECTING:
		state_str = "connecting";
		break;
	case WIFI_MGR_DISCONNECTED:
		state_str = "disconnected";
		break;
	default:
		state_str = "idle";
		break;
	}

	snprintf(buf, sizeof(buf),
		 "PROV:OK:wifi_ssid=%s,wifi_pass=%s,state=%s,ip=%s",
		 ssid[0] ? "SET" : "EMPTY",
		 psk[0] ? "SET" : "EMPTY",
		 state_str,
		 ip[0] ? ip : "none");

	send_response(buf);
}

static void process_line(const char *line)
{
	if (strncmp(line, "PROV:START", 10) == 0) {
		handle_prov_start();
	} else if (strncmp(line, "PROV:SET:", 9) == 0) {
		handle_prov_set(line + 9);
	} else if (strncmp(line, "PROV:COMMIT", 11) == 0) {
		handle_prov_commit();
	} else if (strncmp(line, "PROV:STATUS", 11) == 0) {
		handle_prov_status();
	}
	/* Ignore non-PROV lines silently */
}

/**
 * Polling thread — reads from USB Serial/JTAG using uart_poll_in().
 * This works reliably with the espressif,esp32-usb-serial driver
 * which may not fully support IRQ-driven RX.
 */
static void prov_poll_thread(void *p1, void *p2, void *p3)
{
	ARG_UNUSED(p1);
	ARG_UNUSED(p2);
	ARG_UNUSED(p3);

	unsigned char c;

	LOG_INF("Provisioning poll thread started");

	while (1) {
		/* Non-blocking read: returns 0 on success, -1 if no data */
		while (uart_poll_in(uart_dev, &c) == 0) {
			if (c == '\n' || c == '\r') {
				if (rx_pos > 0) {
					rx_buf[rx_pos] = '\0';
					process_line(rx_buf);
					rx_pos = 0;
				}
			} else if (rx_pos < PROV_BUF_SIZE - 1) {
				rx_buf[rx_pos++] = (char)c;
			}
		}

		k_sleep(K_MSEC(PROV_POLL_MS));
	}
}

void prov_shell_init(void)
{
	uart_dev = DEVICE_DT_GET(DT_CHOSEN(zephyr_console));

	if (!device_is_ready(uart_dev)) {
		LOG_ERR("UART device not ready");
		return;
	}

	rx_pos = 0;

	/* Start polling thread */
	k_thread_create(&prov_thread_data, prov_stack,
			K_THREAD_STACK_SIZEOF(prov_stack),
			prov_poll_thread, NULL, NULL, NULL,
			7, 0, K_NO_WAIT);
	k_thread_name_set(&prov_thread_data, "prov_poll");

	LOG_INF("Provisioning shell initialized (polling mode)");
}
```

## src/prov_shell.h
```c
/*
 * Provisioning Shell — header
 *
 * PROV:* serial protocol handler for credential provisioning.
 */

#ifndef PROV_SHELL_H
#define PROV_SHELL_H

/** Initialize the provisioning UART listener */
void prov_shell_init(void);

#endif /* PROV_SHELL_H */
```

## src/wifi_config.c
```c
/*
 * WiFi Config — flash partition reader
 *
 * Reads a wifi_config struct from the scratch partition (0x3E0000).
 * This area is unused without MCUboot OTA updates.
 *
 * The UNAL Flash Tool web interface generates this binary blob
 * and flashes it at the same offset alongside the firmware.
 */

#include <zephyr/kernel.h>
#include <zephyr/storage/flash_map.h>
#include <zephyr/logging/log.h>
#include <string.h>

#include "wifi_config.h"

LOG_MODULE_REGISTER(wifi_config, LOG_LEVEL_INF);

int wifi_config_load(char *ssid, size_t ssid_len,
		     char *psk, size_t psk_len)
{
	const struct flash_area *fa;
	struct wifi_config cfg;
	int ret;

	ret = flash_area_open(FIXED_PARTITION_ID(scratch_partition), &fa);
	if (ret != 0) {
		LOG_ERR("Failed to open scratch partition (%d)", ret);
		return -1;
	}

	ret = flash_area_read(fa, 0, &cfg, sizeof(cfg));
	flash_area_close(fa);
	if (ret != 0) {
		LOG_ERR("Failed to read config from flash (%d)", ret);
		return -1;
	}

	/* Validate magic */
	if (cfg.magic != WIFI_CONFIG_MAGIC) {
		LOG_INF("No WiFi config found in flash (magic: 0x%08x)",
			cfg.magic);
		return -1;
	}

	/* Validate version */
	if (cfg.version != WIFI_CONFIG_VERSION) {
		LOG_WRN("Config version mismatch (%u != %u)",
			cfg.version, WIFI_CONFIG_VERSION);
		return -1;
	}

	/* Validate lengths */
	if (cfg.ssid_len == 0 || cfg.ssid_len > WIFI_CONFIG_SSID_MAX) {
		LOG_WRN("Invalid SSID length: %u", cfg.ssid_len);
		return -1;
	}

	if (cfg.psk_len > WIFI_CONFIG_PSK_MAX) {
		LOG_WRN("Invalid PSK length: %u", cfg.psk_len);
		return -1;
	}

	/* Copy SSID */
	size_t copy_len = cfg.ssid_len;
	if (copy_len >= ssid_len) {
		copy_len = ssid_len - 1;
	}
	memcpy(ssid, cfg.ssid, copy_len);
	ssid[copy_len] = '\0';

	/* Copy PSK */
	copy_len = cfg.psk_len;
	if (copy_len >= psk_len) {
		copy_len = psk_len - 1;
	}
	memcpy(psk, cfg.psk, copy_len);
	psk[copy_len] = '\0';

	LOG_INF("WiFi config loaded from flash — SSID: %s", ssid);
	return 0;
}
```

## src/wifi_config.h
```c
/*
 * WiFi Config — binary config partition format
 *
 * Defines the binary struct that is stored at a fixed flash offset
 * and generated by the UNAL Flash Tool web interface.
 *
 * The web tool generates this blob in the browser and flashes it
 * alongside the firmware binary — no serial provisioning needed.
 *
 * Layout (128 bytes total, 4KB-aligned for flash sector erase):
 *   Offset  Size  Field
 *   0x00    4     magic       (0x57494649 = "WIFI")
 *   0x04    1     version     (1)
 *   0x05    1     ssid_len
 *   0x06    1     psk_len
 *   0x07    1     flags       (reserved)
 *   0x08    33    ssid        (null-terminated, max 32 chars)
 *   0x29    65    psk         (null-terminated, max 64 chars)
 *   0x6A    22    reserved    (0xFF padding)
 */

#ifndef WIFI_CONFIG_H
#define WIFI_CONFIG_H

#include <stdint.h>
#include <stddef.h>

#define WIFI_CONFIG_MAGIC      0x57494649  /* "WIFI" in ASCII */
#define WIFI_CONFIG_VERSION    1
#define WIFI_CONFIG_SSID_MAX   32
#define WIFI_CONFIG_PSK_MAX    64

struct wifi_config {
	uint32_t magic;
	uint8_t  version;
	uint8_t  ssid_len;
	uint8_t  psk_len;
	uint8_t  flags;
	char     ssid[WIFI_CONFIG_SSID_MAX + 1];
	char     psk[WIFI_CONFIG_PSK_MAX + 1];
	uint8_t  reserved[22];
} __attribute__((packed));

/* Compile-time check: struct must be exactly 128 bytes */
_Static_assert(sizeof(struct wifi_config) == 128,
	       "wifi_config struct must be 128 bytes");

/**
 * Read WiFi config from the config flash partition.
 * Returns 0 if a valid config was found, -1 otherwise.
 */
int wifi_config_load(char *ssid, size_t ssid_len,
		     char *psk, size_t psk_len);

#endif /* WIFI_CONFIG_H */
```

## src/wifi_mgr.h
```c
/*
 * WiFi Manager — header
 *
 * Manages WiFi connection lifecycle and NVS credential storage.
 */

#ifndef WIFI_MGR_H
#define WIFI_MGR_H

#include <stddef.h>

enum wifi_mgr_state {
	WIFI_MGR_IDLE = 0,
	WIFI_MGR_CONNECTING,
	WIFI_MGR_CONNECTED,
	WIFI_MGR_DISCONNECTED,
};

/** Initialize the WiFi manager (NVS + net mgmt callbacks) */
int wifi_mgr_init(void);

/** Load credentials from NVS. Returns 0 on success, -1 if not found. */
int wifi_mgr_load_credentials(char *ssid, size_t ssid_len,
			      char *psk, size_t psk_len);

/** Save credentials to NVS. Returns 0 on success. */
int wifi_mgr_save_credentials(const char *ssid, const char *psk);

/** Connect to WiFi with given SSID and PSK. */
int wifi_mgr_connect(const char *ssid, const char *psk);

/** Disconnect from WiFi. */
int wifi_mgr_disconnect(void);

/** Get current WiFi state. */
enum wifi_mgr_state wifi_mgr_get_state(void);

/** Get the assigned IP address string (after DHCP). */
const char *wifi_mgr_get_ip(void);

#endif /* WIFI_MGR_H */
```

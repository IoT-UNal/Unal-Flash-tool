## CMakeLists.txt
```
cmake_minimum_required(VERSION 3.20.0)
find_package(Zephyr REQUIRED HINTS $ENV{ZEPHYR_BASE})

project(unal_rgb)

target_sources(app PRIVATE
  src/main.c
  src/led_config.c
  src/rgb_led.c
  src/led_ctrl.c
)
```

## prj.conf
```kconfig
# UNAL RGB LED Firmware — Zephyr Configuration
# Target: ESP32-C6 Super Mini (WS2812B RGB LED on GPIO8)

# ──── Core ────
CONFIG_GPIO=y
CONFIG_CONSOLE=y
CONFIG_UART_CONSOLE=y
CONFIG_SERIAL=y
CONFIG_PRINTK=y
CONFIG_BOOT_BANNER=y
CONFIG_HEAP_MEM_POOL_SIZE=65536
CONFIG_MAIN_STACK_SIZE=8192

# ──── Logging ────
CONFIG_LOG=y
CONFIG_LOG_DEFAULT_LEVEL=3

# ──── NVS / Flash (LED config storage) ────
CONFIG_NVS=y
CONFIG_FLASH=y
CONFIG_FLASH_MAP=y
```

## src/main.c
```c
/*
 * UNAL Flash Tool — RGB LED Firmware (Zephyr RTOS)
 *
 * Target: ESP32-C6 Super Mini (WS2812B RGB LED on GPIO 8)
 *
 * Boot sequence:
 *   1. Init WS2812 RGB LED driver
 *   2. Load LED config from flash partition (offset 128)
 *   3. Start LED controller thread (runs chosen animation)
 *   4. Main loop: periodic heartbeat log
 *
 * Config partition layout (scratch_partition @ 0x3E0000):
 *   [128..191]  LED config   ( 64 bytes — struct led_config)
 */

#include <zephyr/kernel.h>
#include <zephyr/sys/printk.h>
#include <zephyr/logging/log.h>
#include <version.h>

#include "led_config.h"
#include "rgb_led.h"
#include "led_ctrl.h"

LOG_MODULE_REGISTER(main, LOG_LEVEL_INF);

int main(void)
{
	int ret;

	printk("\n========================================\n");
	printk("  UNAL Flash Tool — RGB LED Firmware\n");
	printk("  Framework: Zephyr RTOS %s\n", KERNEL_VERSION_STRING);
	printk("  Board: %s\n", CONFIG_BOARD);
	printk("  LED: WS2812B on GPIO 8\n");
	printk("========================================\n\n");

	/* ── 1. Initialise RGB LED driver ─────────────────────────── */
	ret = rgb_led_init();
	if (ret < 0) {
		LOG_ERR("RGB LED init failed (%d)", ret);
	}

	/* ── 2. Load LED config from flash ───────────────────────── */
	struct led_config led_cfg;
	if (led_config_load(&led_cfg) != 0) {
		LOG_INF("Using default LED config");
		led_config_defaults(&led_cfg);
	}

	/* ── 3. Start LED controller thread ──────────────────────── */
	led_ctrl_start(&led_cfg);

	/* ── 4. Heartbeat loop ───────────────────────────────────── */
	while (1) {
		printk("[%08u] LED mode: %u | Uptime: %lld ms\n",
		       k_uptime_get_32(), led_cfg.mode, k_uptime_get());
		k_sleep(K_SECONDS(5));
	}

	return 0;
}
```

## src/led_config.c
```c
/*
 * LED Config — flash partition reader
 *
 * Reads led_config from offset 128 in the scratch partition.
 */

#include <zephyr/kernel.h>
#include <zephyr/storage/flash_map.h>
#include <zephyr/logging/log.h>
#include <string.h>

#include "led_config.h"

LOG_MODULE_REGISTER(led_config, LOG_LEVEL_INF);

/* LED config at offset 128 in the scratch partition */
#define LED_CONFIG_FLASH_OFFSET 128

int led_config_load(struct led_config *cfg)
{
	const struct flash_area *fa;
	int ret;

	ret = flash_area_open(FIXED_PARTITION_ID(scratch_partition), &fa);
	if (ret != 0) {
		LOG_ERR("Failed to open scratch partition (%d)", ret);
		return -1;
	}

	ret = flash_area_read(fa, LED_CONFIG_FLASH_OFFSET, cfg, sizeof(*cfg));
	flash_area_close(fa);
	if (ret != 0) {
		LOG_ERR("Failed to read LED config from flash (%d)", ret);
		return -1;
	}

	if (cfg->magic != LED_CONFIG_MAGIC) {
		LOG_INF("No LED config in flash (magic: 0x%08x)", cfg->magic);
		return -1;
	}

	if (cfg->version != LED_CONFIG_VERSION) {
		LOG_WRN("LED config version mismatch (%u != %u)",
			cfg->version, LED_CONFIG_VERSION);
		return -1;
	}

	LOG_INF("LED config loaded — mode:%u bright:%u speed:%u "
		"color:#%02x%02x%02x",
		cfg->mode, cfg->brightness, cfg->speed,
		cfg->color_r, cfg->color_g, cfg->color_b);

	return 0;
}

void led_config_defaults(struct led_config *cfg)
{
	memset(cfg, 0xff, sizeof(*cfg));
	cfg->magic      = LED_CONFIG_MAGIC;
	cfg->version    = LED_CONFIG_VERSION;
	cfg->mode       = LED_MODE_SOLID;
	cfg->brightness = 128;  /* ~50 % — visible but not blinding */
	cfg->speed      = 128;  /* medium */
	cfg->color_r    = 0;
	cfg->color_g    = 120;
	cfg->color_b    = 255;
	cfg->flags      = 0;
}
```

## src/led_config.h
```c
/*
 * LED Config — binary config partition format
 *
 * Defines the LED configuration struct stored at offset 128
 * within the scratch partition.
 *
 * Generated by the UNAL Flash Tool web interface and flashed
 * alongside the firmware binary.
 *
 * Layout (64 bytes):
 *   Offset  Size  Field
 *   0x00    4     magic        (0x4C454443 = "LEDC")
 *   0x04    1     version      (1)
 *   0x05    1     mode         (0=solid,1=blink,2=breathe,3=rainbow)
 *   0x06    1     brightness   (0–255)
 *   0x07    1     speed        (1–255, animation tick rate)
 *   0x08    1     color_r      (primary R)
 *   0x09    1     color_g      (primary G)
 *   0x0A    1     color_b      (primary B)
 *   0x0B    1     flags        (reserved, 0)
 *   0x0C    52    reserved     (0xFF)
 */

#ifndef LED_CONFIG_H
#define LED_CONFIG_H

#include <stdint.h>

#define LED_CONFIG_MAGIC   0x4C454443  /* "LEDC" in ASCII */
#define LED_CONFIG_VERSION 1

/* LED behaviour modes */
enum led_mode {
	LED_MODE_SOLID        = 0,
	LED_MODE_BLINK        = 1,
	LED_MODE_BREATHE      = 2,
	LED_MODE_RAINBOW      = 3,
};

struct led_config {
	uint32_t magic;
	uint8_t  version;
	uint8_t  mode;
	uint8_t  brightness;
	uint8_t  speed;
	uint8_t  color_r;
	uint8_t  color_g;
	uint8_t  color_b;
	uint8_t  flags;
	uint8_t  reserved[52];
} __attribute__((packed));

_Static_assert(sizeof(struct led_config) == 64,
	       "led_config struct must be 64 bytes");

/**
 * Read LED config from the config flash partition (offset 128).
 * Populates *cfg on success.  Returns 0 if valid, -1 otherwise.
 */
int led_config_load(struct led_config *cfg);

/**
 * Fill cfg with sensible defaults (wifi_status mode, white, full brightness).
 */
void led_config_defaults(struct led_config *cfg);

#endif /* LED_CONFIG_H */
```

## src/led_ctrl.c
```c
/*
 * LED Controller — behaviour engine
 *
 * Dedicated thread that drives the WS2812 LED according to the
 * selected mode.  The config can be updated at runtime from any
 * context — a mutex protects the shared state.
 */

#include <zephyr/kernel.h>
#include <zephyr/logging/log.h>
#include <string.h>
#include <math.h>

#include "led_ctrl.h"
#include "rgb_led.h"

LOG_MODULE_REGISTER(led_ctrl, LOG_LEVEL_INF);

/* ── thread resources ────────────────────────────────────────────── */

#define LED_STACK_SIZE 1024
#define LED_PRIORITY   7

static K_THREAD_STACK_DEFINE(led_stack, LED_STACK_SIZE);
static struct k_thread led_thread;

static struct k_mutex cfg_mutex;
static struct led_config active_cfg;

/* ── helpers ─────────────────────────────────────────────────────── */

/* Scale an 8-bit colour channel by a 0-255 brightness value */
static inline uint8_t scale(uint8_t ch, uint8_t bright)
{
	return (uint8_t)(((uint16_t)ch * (uint16_t)bright) / 255U);
}

/* Convert HSV (h 0-360, s/v 0-255) to RGB */
static void hsv_to_rgb(uint16_t h, uint8_t s, uint8_t v,
		       uint8_t *r, uint8_t *g, uint8_t *b)
{
	if (s == 0) {
		*r = *g = *b = v;
		return;
	}

	uint8_t region = h / 60;
	uint8_t remainder = (uint8_t)((h - (region * 60)) * 255 / 60);

	uint8_t p = (uint8_t)((uint16_t)v * (255 - s) / 255);
	uint8_t q = (uint8_t)((uint16_t)v * (255 - ((uint16_t)s * remainder / 255)) / 255);
	uint8_t t = (uint8_t)((uint16_t)v * (255 - ((uint16_t)s * (255 - remainder) / 255)) / 255);

	switch (region) {
	case 0:  *r = v; *g = t; *b = p; break;
	case 1:  *r = q; *g = v; *b = p; break;
	case 2:  *r = p; *g = v; *b = t; break;
	case 3:  *r = p; *g = q; *b = v; break;
	case 4:  *r = t; *g = p; *b = v; break;
	default: *r = v; *g = p; *b = q; break;
	}
}

/* Speed (1-255) → tick period in ms.  1 = slow (100 ms), 255 = fast (10 ms) */
static uint32_t speed_to_ms(uint8_t speed)
{
	if (speed == 0) {
		speed = 1;
	}
	/* Linear map: speed 1 → 100 ms, speed 255 → 10 ms */
	return 100 - (uint32_t)(speed - 1) * 90 / 254;
}

/* ── animation implementations ───────────────────────────────────── */

static void do_solid(const struct led_config *c)
{
	rgb_led_set(scale(c->color_r, c->brightness),
		    scale(c->color_g, c->brightness),
		    scale(c->color_b, c->brightness));
}

/* Blink: on for half-period, off for half-period */
static void do_blink(const struct led_config *c, uint32_t tick)
{
	/* period = 20 ticks (on for 10, off for 10) */
	if ((tick / 10) % 2 == 0) {
		do_solid(c);
	} else {
		rgb_led_off();
	}
}

/* Breathe: sinusoidal brightness modulation */
static void do_breathe(const struct led_config *c, uint32_t tick)
{
	/* triangular wave 0→255→0 over 512 ticks */
	uint32_t phase = tick % 512;
	uint8_t breath;
	if (phase < 256) {
		breath = (uint8_t)phase;
	} else {
		breath = (uint8_t)(511 - phase);
	}
	uint8_t b = scale(c->brightness, breath);
	rgb_led_set(scale(c->color_r, b),
		    scale(c->color_g, b),
		    scale(c->color_b, b));
}

/* Rainbow: cycle through hue at configured brightness */
static void do_rainbow(const struct led_config *c, uint32_t tick)
{
	uint16_t hue = (uint16_t)(tick % 360);
	uint8_t r, g, b;
	hsv_to_rgb(hue, 255, c->brightness, &r, &g, &b);
	rgb_led_set(r, g, b);
}

/* ── thread entry ────────────────────────────────────────────────── */

static void led_thread_fn(void *p1, void *p2, void *p3)
{
	ARG_UNUSED(p1);
	ARG_UNUSED(p2);
	ARG_UNUSED(p3);

	uint32_t tick = 0;

	while (1) {
		struct led_config c;

		k_mutex_lock(&cfg_mutex, K_FOREVER);
		memcpy(&c, &active_cfg, sizeof(c));
		k_mutex_unlock(&cfg_mutex);

		switch (c.mode) {
		case LED_MODE_SOLID:
			do_solid(&c);
			break;
		case LED_MODE_BLINK:
			do_blink(&c, tick);
			break;
		case LED_MODE_BREATHE:
			do_breathe(&c, tick);
			break;
		case LED_MODE_RAINBOW:
			do_rainbow(&c, tick);
			break;
		default:
			do_solid(&c);
			break;
		}

		tick++;
		k_sleep(K_MSEC(speed_to_ms(c.speed)));
	}
}

/* ── public API ──────────────────────────────────────────────────── */

void led_ctrl_start(const struct led_config *cfg)
{
	k_mutex_init(&cfg_mutex);
	memcpy(&active_cfg, cfg, sizeof(active_cfg));

	k_thread_create(&led_thread, led_stack,
			K_THREAD_STACK_SIZEOF(led_stack),
			led_thread_fn, NULL, NULL, NULL,
			LED_PRIORITY, 0, K_NO_WAIT);

	LOG_INF("LED controller started — mode %u", cfg->mode);
}

void led_ctrl_update(const struct led_config *cfg)
{
	k_mutex_lock(&cfg_mutex, K_FOREVER);
	memcpy(&active_cfg, cfg, sizeof(*cfg));
	k_mutex_unlock(&cfg_mutex);
}
```

## src/led_ctrl.h
```c
/*
 * LED Controller — behaviour engine
 *
 * Runs the configured LED animation in a background thread.
 * Supports: solid, blink, breathe, rainbow, and wifi-status modes.
 */

#ifndef LED_CTRL_H
#define LED_CTRL_H

#include "led_config.h"

/** Start the LED controller thread with the given config. */
void led_ctrl_start(const struct led_config *cfg);

/**
 * Update the config at runtime (thread-safe).
 * Takes effect on the next animation tick.
 */
void led_ctrl_update(const struct led_config *cfg);

#endif /* LED_CTRL_H */
```

## src/rgb_led.c
```c
/*
 * RGB LED — WS2812 single-pixel driver (GPIO bit-bang)
 *
 * Sends 24 bits (GRB order, MSB-first) over a single GPIO pin using
 * direct register writes and the CPU cycle counter (160 MHz) for
 * tight timing.  Interrupts are locked for the duration of the
 * 24-bit frame (~30 µs) to avoid jitter.
 *
 * Previous version used k_cycle_get_32() (16 MHz systimer) and the
 * Zephyr GPIO driver API, whose combined overhead (~200 ns) pushed
 * T0H above the WS2812B spec max (550 ns), corrupting data.
 *
 * WS2812B timing (±150 ns tolerance):
 *   0-bit : HIGH 400 ns, LOW 850 ns
 *   1-bit : HIGH 800 ns, LOW 450 ns
 *   Reset : LOW  ≥ 50 µs
 *
 * Target: ESP32-C6 Super Mini — WS2812B on GPIO 8
 */

#include <zephyr/kernel.h>
#include <zephyr/drivers/gpio.h>
#include <zephyr/logging/log.h>

#include "rgb_led.h"

LOG_MODULE_REGISTER(rgb_led, LOG_LEVEL_INF);

/* ── hardware constants ──────────────────────────────────────────── */

#define WS2812_GPIO_NODE  DT_NODELABEL(gpio0)
#define WS2812_GPIO_PIN   8          /* ESP32-C6 Super Mini onboard LED */
#define PIN_BIT           (1U << WS2812_GPIO_PIN)

/*
 * ESP32-C6 GPIO register addresses (direct write, no driver overhead).
 * DR_REG_GPIO_BASE = 0x60091000 on ESP32-C6.
 */
#define GPIO_OUT_W1TS_ADDR  0x60091008U   /* Set output high   */
#define GPIO_OUT_W1TC_ADDR  0x6009100CU   /* Set output low    */

#define GPIO_SET_HIGH()  (*(volatile uint32_t *)GPIO_OUT_W1TS_ADDR = PIN_BIT)
#define GPIO_SET_LOW()   (*(volatile uint32_t *)GPIO_OUT_W1TC_ADDR = PIN_BIT)

/* Nanosecond timing targets */
#define T0H_NS   400
#define T0L_NS   850
#define T1H_NS   800
#define T1L_NS   450

/*
 * ESP32-C6 CPU frequency: 160 MHz (default, from 40 MHz XTAL × 4 PLL).
 * The RISC-V performance counter (CSR 0x7E2) ticks at this rate.
 */
#define CPU_FREQ_MHZ  160

/* ── module state ────────────────────────────────────────────────── */

static const struct device *gpio_dev;
static bool initialised;

/* Pre-computed CPU cycle counts */
static uint32_t t0h_cyc;
static uint32_t t0l_cyc;
static uint32_t t1h_cyc;
static uint32_t t1l_cyc;

/*
 * Gamma correction LUT (gamma ≈ 2.8).
 * Converts sRGB colour values to linearised PWM values so that the
 * perceived LED colour matches the colour shown in the web picker.
 */
static const uint8_t gamma_lut[256] = {
	  0,  0,  0,  0,  0,  0,  0,  0,  0,  0,  0,  0,  0,  0,  0,  0,
	  0,  0,  0,  0,  0,  0,  0,  0,  0,  0,  0,  0,  1,  1,  1,  1,
	  1,  1,  1,  1,  1,  1,  1,  1,  1,  2,  2,  2,  2,  2,  2,  2,
	  2,  3,  3,  3,  3,  3,  3,  3,  4,  4,  4,  4,  4,  5,  5,  5,
	  5,  6,  6,  6,  6,  7,  7,  7,  7,  8,  8,  8,  9,  9,  9, 10,
	 10, 10, 11, 11, 11, 12, 12, 13, 13, 13, 14, 14, 15, 15, 16, 16,
	 17, 17, 18, 18, 19, 19, 20, 20, 21, 21, 22, 22, 23, 24, 24, 25,
	 25, 26, 27, 27, 28, 29, 29, 30, 31, 32, 32, 33, 34, 35, 35, 36,
	 37, 38, 39, 39, 40, 41, 42, 43, 44, 45, 46, 47, 48, 49, 50, 50,
	 51, 52, 54, 55, 56, 57, 58, 59, 60, 61, 62, 63, 64, 66, 67, 68,
	 69, 70, 72, 73, 74, 75, 77, 78, 79, 81, 82, 83, 85, 86, 87, 89,
	 90, 92, 93, 95, 96, 98, 99,101,102,104,105,107,109,110,112,114,
	115,117,119,120,122,124,126,127,129,131,133,135,137,138,140,142,
	144,146,148,150,152,154,156,158,160,162,164,167,169,171,173,175,
	177,180,182,184,186,189,191,193,196,198,200,203,205,208,210,213,
	215,218,220,223,225,228,231,233,236,239,241,244,247,249,252,255,
};

/* ── helpers ─────────────────────────────────────────────────────── */

static inline uint32_t ns_to_cpu_cycles(uint32_t ns)
{
	return (uint32_t)((uint64_t)ns * CPU_FREQ_MHZ / 1000ULL);
}

/*
 * Read CPU cycle counter (RISC-V performance counter CSR 0x7E2).
 * Runs at CPU_FREQ_MHZ (160 MHz → 6.25 ns resolution).
 */
static inline uint32_t cpu_cycles_now(void)
{
	uint32_t cycles;
	__asm__ volatile("csrr %0, 0x7e2" : "=r"(cycles));
	return cycles;
}

static inline void spin_until(uint32_t start, uint32_t cycles)
{
	while ((cpu_cycles_now() - start) < cycles) {
		/* busy-wait */
	}
}

/* Send a single bit — must be called with IRQs locked */
static inline void send_bit(int bit)
{
	uint32_t t;

	GPIO_SET_HIGH();
	t = cpu_cycles_now();
	spin_until(t, bit ? t1h_cyc : t0h_cyc);

	GPIO_SET_LOW();
	t = cpu_cycles_now();
	spin_until(t, bit ? t1l_cyc : t0l_cyc);
}

/* Send one byte, MSB first */
static inline void send_byte(uint8_t val)
{
	for (int i = 7; i >= 0; i--) {
		send_bit((val >> i) & 1);
	}
}

/* ── public API ──────────────────────────────────────────────────── */

int rgb_led_init(void)
{
	gpio_dev = DEVICE_DT_GET(WS2812_GPIO_NODE);
	if (!device_is_ready(gpio_dev)) {
		LOG_ERR("GPIO device not ready");
		return -ENODEV;
	}

	int ret = gpio_pin_configure(gpio_dev, WS2812_GPIO_PIN,
				     GPIO_OUTPUT_LOW);
	if (ret < 0) {
		LOG_ERR("Failed to configure GPIO%d (%d)", WS2812_GPIO_PIN, ret);
		return ret;
	}

	/* Pre-compute CPU cycle counts (160 MHz) */
	t0h_cyc = ns_to_cpu_cycles(T0H_NS);
	t0l_cyc = ns_to_cpu_cycles(T0L_NS);
	t1h_cyc = ns_to_cpu_cycles(T1H_NS);
	t1l_cyc = ns_to_cpu_cycles(T1L_NS);

	LOG_INF("WS2812 on GPIO%d  —  cpu_freq: %u MHz  "
		"t0h:%u t0l:%u t1h:%u t1l:%u",
		WS2812_GPIO_PIN, CPU_FREQ_MHZ,
		t0h_cyc, t0l_cyc, t1h_cyc, t1l_cyc);

	initialised = true;
	return 0;
}

void rgb_led_set(uint8_t r, uint8_t g, uint8_t b)
{
	if (!initialised) {
		return;
	}

	/* Gamma-correct each channel for perceptual colour accuracy */
	r = gamma_lut[r];
	g = gamma_lut[g];
	b = gamma_lut[b];

	/* WS2812 expects GRB byte order */
	unsigned int key = irq_lock();
	send_byte(g);
	send_byte(r);
	send_byte(b);
	irq_unlock(key);

	/* Reset pulse: >50 µs low (pin is already low after last bit) */
	k_busy_wait(80);
}

void rgb_led_off(void)
{
	rgb_led_set(0, 0, 0);
}
```

## src/rgb_led.h
```c
/*
 * RGB LED — WS2812 single-pixel driver (GPIO bit-bang)
 *
 * Bit-bangs the WS2812 protocol on a configurable GPIO pin.
 * Uses Zephyr's hardware cycle counter for sub-µs timing.
 *
 * Target: ESP32-C6 Super Mini — WS2812B on GPIO 8
 */

#ifndef RGB_LED_H
#define RGB_LED_H

#include <stdint.h>

/** Initialise the WS2812 GPIO pin.  Returns 0 on success. */
int rgb_led_init(void);

/** Set the LED colour immediately (blocking, ~30 µs with IRQs off). */
void rgb_led_set(uint8_t r, uint8_t g, uint8_t b);

/** Turn the LED off. */
void rgb_led_off(void);

#endif /* RGB_LED_H */
```

## src/wifi_mgr.c
```c
/*
 * WiFi Manager — implementation
 *
 * Handles WiFi STA connection using Zephyr net_mgmt API,
 * with NVS-backed credential storage.
 */

#include <zephyr/kernel.h>
#include <zephyr/net/net_if.h>
#include <zephyr/net/wifi_mgmt.h>
#include <zephyr/net/net_event.h>
#include <zephyr/net/dhcpv4.h>
#include <zephyr/settings/settings.h>
#include <zephyr/drivers/flash.h>
#include <zephyr/storage/flash_map.h>
#include <zephyr/fs/nvs.h>
#include <zephyr/logging/log.h>
#include <string.h>
#include <stdio.h>

#include "wifi_mgr.h"

LOG_MODULE_REGISTER(wifi_mgr, LOG_LEVEL_INF);

/* NVS IDs for credential storage */
#define NVS_SSID_ID    1
#define NVS_PSK_ID     2

/* NVS partition — uses "storage" partition from devicetree */
#define NVS_PARTITION  storage_partition
#define NVS_PARTITION_DEVICE FIXED_PARTITION_DEVICE(NVS_PARTITION)
#define NVS_PARTITION_OFFSET FIXED_PARTITION_OFFSET(NVS_PARTITION)
#define NVS_PARTITION_SIZE   FIXED_PARTITION_SIZE(NVS_PARTITION)

static struct nvs_fs nvs;
static enum wifi_mgr_state current_state = WIFI_MGR_IDLE;
static char ip_addr_str[NET_IPV4_ADDR_LEN] = {0};

static struct net_mgmt_event_callback wifi_cb;
static struct net_mgmt_event_callback ipv4_cb;

/* Semaphore to signal connection result */
static K_SEM_DEFINE(wifi_connected_sem, 0, 1);

static void wifi_event_handler(struct net_mgmt_event_callback *cb,
			       uint64_t mgmt_event, struct net_if *iface)
{
	switch (mgmt_event) {
	case NET_EVENT_WIFI_CONNECT_RESULT: {
		const struct wifi_status *status =
			(const struct wifi_status *)cb->info;

		if (status->status) {
			LOG_ERR("WiFi connection failed (%d)", status->status);
			current_state = WIFI_MGR_DISCONNECTED;
		} else {
			LOG_INF("WiFi connected!");
			current_state = WIFI_MGR_CONNECTED;
			k_sem_give(&wifi_connected_sem);
		}
		break;
	}
	case NET_EVENT_WIFI_DISCONNECT_RESULT: {
		LOG_INF("WiFi disconnected");
		current_state = WIFI_MGR_DISCONNECTED;
		memset(ip_addr_str, 0, sizeof(ip_addr_str));
		break;
	}
	default:
		break;
	}
}

static void ipv4_event_handler(struct net_mgmt_event_callback *cb,
			       uint64_t mgmt_event, struct net_if *iface)
{
	if (mgmt_event != NET_EVENT_IPV4_ADDR_ADD) {
		return;
	}

	for (int i = 0; i < NET_IF_MAX_IPV4_ADDR; i++) {
		if (iface->config.ip.ipv4->unicast[i].ipv4.is_used) {
			char buf[NET_IPV4_ADDR_LEN];
			struct net_addr *addr = &iface->config.ip.ipv4->unicast[i].ipv4.address;

			if (net_addr_ntop(AF_INET, &addr->in_addr, buf, sizeof(buf))) {
				strncpy(ip_addr_str, buf, sizeof(ip_addr_str) - 1);
				LOG_INF("DHCP IP: %s", ip_addr_str);
			}
			break;
		}
	}
}

int wifi_mgr_init(void)
{
	int ret;

	/* Initialize NVS */
	nvs.flash_device = NVS_PARTITION_DEVICE;
	if (!device_is_ready(nvs.flash_device)) {
		LOG_ERR("Flash device not ready");
		return -ENODEV;
	}

	nvs.offset = NVS_PARTITION_OFFSET;
	nvs.sector_size = 4096;
	nvs.sector_count = NVS_PARTITION_SIZE / nvs.sector_size;

	ret = nvs_mount(&nvs);
	if (ret) {
		LOG_ERR("NVS mount failed (%d)", ret);
		return ret;
	}

	LOG_INF("NVS initialized (sectors: %u)", nvs.sector_count);

	/* Register WiFi event callbacks */
	net_mgmt_init_event_callback(&wifi_cb, wifi_event_handler,
				     NET_EVENT_WIFI_CONNECT_RESULT |
				     NET_EVENT_WIFI_DISCONNECT_RESULT);
	net_mgmt_add_event_callback(&wifi_cb);

	net_mgmt_init_event_callback(&ipv4_cb, ipv4_event_handler,
				     NET_EVENT_IPV4_ADDR_ADD);
	net_mgmt_add_event_callback(&ipv4_cb);

	return 0;
}

int wifi_mgr_load_credentials(char *ssid, size_t ssid_len,
			      char *psk, size_t psk_len)
{
	int ret;

	ret = nvs_read(&nvs, NVS_SSID_ID, ssid, ssid_len - 1);
	if (ret <= 0) {
		return -1;
	}
	ssid[ret] = '\0';

	ret = nvs_read(&nvs, NVS_PSK_ID, psk, psk_len - 1);
	if (ret <= 0) {
		/* Password can be empty (open network) */
		psk[0] = '\0';
	} else {
		psk[ret] = '\0';
	}

	return 0;
}

int wifi_mgr_save_credentials(const char *ssid, const char *psk)
{
	int ret;

	ret = nvs_write(&nvs, NVS_SSID_ID, ssid, strlen(ssid));
	if (ret < 0) {
		LOG_ERR("Failed to write SSID to NVS (%d)", ret);
		return ret;
	}

	if (psk && psk[0] != '\0') {
		ret = nvs_write(&nvs, NVS_PSK_ID, psk, strlen(psk));
		if (ret < 0) {
			LOG_ERR("Failed to write PSK to NVS (%d)", ret);
			return ret;
		}
	}

	LOG_INF("Credentials saved to NVS — SSID: %s", ssid);
	return 0;
}

int wifi_mgr_connect(const char *ssid, const char *psk)
{
	struct net_if *iface = net_if_get_default();

	if (!iface) {
		LOG_ERR("No network interface found");
		return -ENODEV;
	}

	struct wifi_connect_req_params params = {0};

	params.ssid = (const uint8_t *)ssid;
	params.ssid_length = strlen(ssid);
	params.channel = WIFI_CHANNEL_ANY;
	params.band = WIFI_FREQ_BAND_2_4_GHZ;

	if (psk && psk[0] != '\0') {
		params.psk = (const uint8_t *)psk;
		params.psk_length = strlen(psk);
		params.security = WIFI_SECURITY_TYPE_PSK;
	} else {
		params.security = WIFI_SECURITY_TYPE_NONE;
	}

	LOG_INF("Connecting to SSID: %s ...", ssid);
	current_state = WIFI_MGR_CONNECTING;

	int ret = net_mgmt(NET_REQUEST_WIFI_CONNECT, iface, &params,
			   sizeof(struct wifi_connect_req_params));
	if (ret) {
		LOG_ERR("WiFi connect request failed (%d)", ret);
		current_state = WIFI_MGR_DISCONNECTED;
		return ret;
	}

	return 0;
}

int wifi_mgr_disconnect(void)
{
	struct net_if *iface = net_if_get_default();

	if (!iface) {
		return -ENODEV;
	}

	int ret = net_mgmt(NET_REQUEST_WIFI_DISCONNECT, iface, NULL, 0);
	if (ret) {
		LOG_ERR("WiFi disconnect failed (%d)", ret);
	}
	return ret;
}

enum wifi_mgr_state wifi_mgr_get_state(void)
{
	return current_state;
}

const char *wifi_mgr_get_ip(void)
{
	return ip_addr_str;
}
```

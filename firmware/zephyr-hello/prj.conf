## CMakeLists.txt
```
# UNAL Hello World — Zephyr RTOS Firmware
#
# Build:
#   west build -b xiao_esp32c6/esp32c6 firmware/zephyr-hello -d firmware/zephyr-hello/build
#
# Flash:
#   west flash -d firmware/zephyr-hello/build
#   or use esptool.py with the merged binary

cmake_minimum_required(VERSION 3.20.0)
find_package(Zephyr REQUIRED HINTS $ENV{ZEPHYR_BASE})

project(unal-hello-world)

target_sources(app PRIVATE src/main.c)
```

## prj.conf
```kconfig
# UNAL Hello World — Zephyr Configuration

# GPIO for LED blink
CONFIG_GPIO=y

# Serial console output
CONFIG_CONSOLE=y
CONFIG_UART_CONSOLE=y
CONFIG_SERIAL=y

# Printk (lightweight print)
CONFIG_PRINTK=y

# System info
CONFIG_HEAP_MEM_POOL_SIZE=4096

# Logging subsystem
CONFIG_LOG=y
CONFIG_LOG_DEFAULT_LEVEL=3

# Boot banner
CONFIG_BOOT_BANNER=y
```

## src/main.c
```c
/*
 * UNAL Flash Tool — Hello World Firmware (Zephyr RTOS)
 *
 * Blinks the onboard LED and prints heartbeat messages via UART.
 * Target: Seeed XIAO ESP32-C6
 */

#include <zephyr/kernel.h>
#include <zephyr/drivers/gpio.h>
#include <zephyr/sys/printk.h>
#include <version.h>
#include <soc.h>

/* Get LED from devicetree alias "led0" */
#define LED_NODE DT_ALIAS(led0)

#if !DT_NODE_HAS_STATUS_OKAY(LED_NODE)
#error "LED0 alias not defined in devicetree"
#endif

static const struct gpio_dt_spec led = GPIO_DT_SPEC_GET(LED_NODE, gpios);

int main(void)
{
	int ret;
	uint32_t count = 0;

	printk("\n========================================\n");
	printk("  UNAL Flash Tool — Hello World\n");
	printk("  Framework: Zephyr RTOS %s\n", KERNEL_VERSION_STRING);
	printk("  Board: %s\n", CONFIG_BOARD);
	printk("========================================\n\n");

	if (!gpio_is_ready_dt(&led)) {
		printk("ERROR: LED GPIO not ready\n");
		return -1;
	}

	ret = gpio_pin_configure_dt(&led, GPIO_OUTPUT_ACTIVE);
	if (ret < 0) {
		printk("ERROR: Could not configure LED pin (%d)\n", ret);
		return -1;
	}

	printk("LED initialized on GPIO %d\n\n", led.pin);

	while (1) {
		gpio_pin_toggle_dt(&led);
		count++;

		printk("[%08u] Hello from UNAL! LED blink #%u | "
		       "Uptime: %lld ms\n",
		       k_uptime_get_32(), count, k_uptime_get());

		k_sleep(K_MSEC(1000));
	}

	return 0;
}
```
